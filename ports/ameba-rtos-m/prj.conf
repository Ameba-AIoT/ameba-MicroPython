## prj.conf
```kconfig
# Kconfig overrides for PKE8721DAF (RTL8721DAF)
# Generated by: python menuconfig.py -s <path>/prj.conf
CONFIG_SHELL=n
CONFIG_SUPPORT_ATCMD=n
CONFIG_ATCMD_NETWORK=n
CONFIG_DIAGNOSE_EN_MENU=y
CONFIG_STANDARD_TICKLESS=y
```

## src/ameba_flash.c
```c
/*
 * This file is part of the Micro Python project, http://micropython.org/
 *
 * The MIT License (MIT)
 *
 * Copyright (c) 2017 Chester Tseng
 * Copyright (c) 2021 Huang Yue
 * Copyright (c) 2022 Simon Xi 
 *
 * Permission is hereby granted, free of charge, to any person obtaining a copy
 * of this software and associated documentation files (the "Software"), to deal
 * in the Software without restriction, including without limitation the rights
 * to use, copy, modify, merge, publish, distribute, sublicense, and/or sell
 * copies of the Software, and to permit persons to whom the Software is
 * furnished to do so, subject to the following conditions:
 *
 * The above copyright notice and this permission notice shall be included in
 * all copies or substantial portions of the Software.
 *
 * THE SOFTWARE IS PROVIDED "AS IS", WITHOUT WARRANTY OF ANY KIND, EXPRESS OR
 * IMPLIED, INCLUDING BUT NOT LIMITED TO THE WARRANTIES OF MERCHANTABILITY,
 * FITNESS FOR A PARTICULAR PURPOSE AND NONINFRINGEMENT. IN NO EVENT SHALL THE
 * AUTHORS OR COPYRIGHT HOLDERS BE LIABLE FOR ANY CLAIM, DAMAGES OR OTHER
 * LIABILITY, WHETHER IN AN ACTION OF CONTRACT, TORT OR OTHERWISE, ARISING FROM,
 * OUT OF OR IN CONNECTION WITH THE SOFTWARE OR THE USE OR OTHER DEALINGS IN
 * THE SOFTWARE.
 */

#include "ameba_flash.h"
#include "flash_api.h"
#include "stdio.h"
#include "extmod/vfs.h"
#include "py/mperrno.h"

#define SECTOR_SIZE_FLASH   4096    // 4KB per sector

// VFS1 region from menuconfig (CONFIG_FLASH_VFS1_* visible via flash_api.h include chain)
// flash_stream_* APIs expect relative offset from flash start, not absolute address
#define FS_START_OFFSET  (CONFIG_FLASH_VFS1_OFFSET - SPI_FLASH_BASE)
#define FS_SIZE          CONFIG_FLASH_VFS1_SIZE


/*****************************************************************************
 *                              External variables
 * ***************************************************************************/

/*****************************************************************************
 *                              Internal functions
 * ***************************************************************************/
const mp_obj_type_t flash_type;

static flash_obj_t amb_flash_obj = {
        .base = { &flash_type },
        .block_size = SECTOR_SIZE_FLASH,
        .start = FS_START_OFFSET,
        .len = FS_SIZE,
};


static void amb_flash_print(const mp_print_t *print, mp_obj_t self_in, mp_print_kind_t kind) {
    flash_obj_t *self = MP_OBJ_TO_PTR(self_in);
    mp_printf(print, "Flash(start=0x%08x, len=%u)", self->start, self->len);
}

/* Read block(s) --------------------------------------------*/
mp_obj_t amb_flash_readblocks(size_t n_args, const mp_obj_t *args) {
    flash_obj_t *self = MP_OBJ_TO_PTR(args[0]);
    int64_t offset = (int64_t)mp_obj_get_int(args[1]) * self->block_size;
    mp_buffer_info_t bufinfo;
    int res = 0;

    mp_get_buffer_raise(args[2], &bufinfo, MP_BUFFER_WRITE);

    if (n_args == 4) {
        offset += mp_obj_get_int(args[3]);
        //mp_raise_ValueError(MP_ERROR_TEXT("offset addressing not supported"));
    }

    // block_num (and the optional byte offset) come straight from the
    // Python caller -- flash_stream_read() has no bounds checking of its
    // own and will happily read from anywhere in the SoC's 32-bit address
    // space, so an out-of-range value here previously turned into a hard
    // Bus Fault / heap corruption instead of a clean OSError.
    if (offset < 0 || (uint64_t)offset + bufinfo.len > self->len) {
        mp_raise_OSError(MP_EIO);
    }

    res = flash_stream_read(NULL, self->start + (uint32_t)offset, bufinfo.len, (uint8_t *) bufinfo.buf);
    if (res != 1) {  /* SDK returns 1 on success, not 0 */
        mp_raise_OSError(MP_EIO);
    }
    return MP_OBJ_NEW_SMALL_INT(0);
}
static MP_DEFINE_CONST_FUN_OBJ_VAR_BETWEEN(amb_flash_readblocks_obj, 3, 4, amb_flash_readblocks);

/* Write block(s) --------------------------------------------*/
mp_obj_t amb_flash_writeblocks(size_t n_args, const mp_obj_t *args) {
    flash_obj_t *self = MP_OBJ_TO_PTR(args[0]);
    int64_t block_num = mp_obj_get_int(args[1]);
    int64_t offset = block_num * self->block_size;
    mp_buffer_info_t bufinfo;
    int res = 0;

    mp_get_buffer_raise(args[2], &bufinfo, MP_BUFFER_READ);

    if (n_args == 4) {
        offset += mp_obj_get_int(args[3]);
    } else if (bufinfo.len % self->block_size != 0) {
        mp_raise_ValueError(MP_ERROR_TEXT("write length must be a multiple of block size"));
    }

    // block_num (and the optional byte offset) come straight from the
    // Python caller -- flash_erase_sector()/flash_stream_write() have no
    // bounds checking of their own, so an out-of-range value here
    // previously turned into a real erase/write at an unintended flash
    // address (or a hard Bus Fault / heap corruption) instead of a clean
    // OSError.
    if (offset < 0 || (uint64_t)offset + bufinfo.len > self->len) {
        mp_raise_OSError(MP_EIO);
    }

    if (n_args != 4) {
        int count = bufinfo.len / self->block_size;
        for (int i = 0; i < count; i++) {
            uint32_t erase_addr = self->start + (uint32_t)(block_num + i) * SECTOR_SIZE_FLASH;
            flash_erase_sector(NULL, erase_addr);
        }
    }

    res = flash_stream_write(NULL, self->start + (uint32_t)offset, bufinfo.len, (uint8_t *) bufinfo.buf);
    if (res != 1) {  /* SDK returns 1 on success, not 0 */
        mp_raise_OSError(MP_EIO);
    }
    return MP_OBJ_NEW_SMALL_INT(0);
}
static MP_DEFINE_CONST_FUN_OBJ_VAR_BETWEEN(amb_flash_writeblocks_obj, 3, 4, amb_flash_writeblocks);


/* IOCTL blocks(s) --------------------------------------------*/
static mp_obj_t amb_flash_ioctl (mp_obj_t self_in, mp_obj_t cmd_in, mp_obj_t arg_in){
    flash_obj_t *self = MP_OBJ_TO_PTR(self_in);
    mp_int_t cmd = mp_obj_get_int(cmd_in);
    
    switch (cmd) {
        case MP_BLOCKDEV_IOCTL_INIT: {
            return MP_OBJ_NEW_SMALL_INT(0);
        }
        case MP_BLOCKDEV_IOCTL_DEINIT: {
            return MP_OBJ_NEW_SMALL_INT(0);
        }
        case MP_BLOCKDEV_IOCTL_SYNC: {
            return MP_OBJ_NEW_SMALL_INT(0);
        }
        //Get sector count
        case MP_BLOCKDEV_IOCTL_BLOCK_COUNT: {
            return MP_OBJ_NEW_SMALL_INT((mp_int_t)(self->len / self->block_size));
        }
        //Get sector size
        case MP_BLOCKDEV_IOCTL_BLOCK_SIZE: {
            return MP_OBJ_NEW_SMALL_INT(self->block_size);
        }
        case MP_BLOCKDEV_IOCTL_BLOCK_ERASE: {
            int64_t block_num = mp_obj_get_int(arg_in);
            // Same out-of-range guard as amb_flash_writeblocks() -- see its
            // comment for why this matters (real erase at an unintended
            // flash address / hard crash instead of a clean OSError).
            if (block_num < 0 || (uint64_t)(block_num + 1) * SECTOR_SIZE_FLASH > self->len) {
                mp_raise_OSError(MP_EIO);
            }
            uint32_t erase_addr = self->start + (uint32_t)block_num * SECTOR_SIZE_FLASH;
            /* erase_addr is relative offset from SPI_FLASH_BASE, same convention as flash_stream_read/write */
            flash_erase_sector(NULL, erase_addr);
            return MP_OBJ_NEW_SMALL_INT(0);
        }
        default: {
            return mp_const_none;
        }
    }
}

static MP_DEFINE_CONST_FUN_OBJ_3(amb_flash_ioctl_obj, amb_flash_ioctl);


static void amb_flash_attr(mp_obj_t self_in, qstr attr, mp_obj_t *dest) {
    if (dest[0] == MP_OBJ_NULL) {
        flash_obj_t *self = MP_OBJ_TO_PTR(self_in);
        if (attr == MP_QSTR_start) {
            dest[0] = mp_obj_new_int_from_uint(self->start);
        } else if (attr == MP_QSTR_len) {
            dest[0] = mp_obj_new_int_from_uint(self->len);
        } else if (attr == MP_QSTR_block_size) {
            dest[0] = mp_obj_new_int_from_uint(self->block_size);
        } else {
            /* Not handled here — signal MicroPython to fall through to locals_dict. */
            dest[1] = MP_OBJ_SENTINEL;
        }
    }
}

static mp_obj_t amb_flash_make_new(const mp_obj_type_t *type, size_t n_args, size_t n_kw, const mp_obj_t *all_args) {
    // Check args.
    mp_arg_check_num(n_args, n_kw, 0, 0, false);
    // Return singleton object.
    return MP_OBJ_FROM_PTR(&amb_flash_obj);
}


static const mp_rom_map_elem_t amb_flash_locals_dict_table[] = {
    { MP_ROM_QSTR(MP_QSTR_readblocks), MP_ROM_PTR(&amb_flash_readblocks_obj) },
    { MP_ROM_QSTR(MP_QSTR_writeblocks), MP_ROM_PTR(&amb_flash_writeblocks_obj) },
    { MP_ROM_QSTR(MP_QSTR_ioctl), MP_ROM_PTR(&amb_flash_ioctl_obj) },
};
static MP_DEFINE_CONST_DICT(amb_flash_locals_dict, amb_flash_locals_dict_table);

MP_DEFINE_CONST_OBJ_TYPE(
    flash_type,
    MP_QSTR_Flash,
    MP_TYPE_FLAG_NONE,
    make_new, amb_flash_make_new,
    print, amb_flash_print,
    attr, amb_flash_attr,
    locals_dict, &amb_flash_locals_dict
);
```

## src/ameba_flash.h
```c
/*
 * This file is part of the Micro Python project, http://micropython.org/
 *
 * The MIT License (MIT)
 *
 * Copyright (c) 2017 Chester Tseng
 *
 * Permission is hereby granted, free of charge, to any person obtaining a copy
 * of this software and associated documentation files (the "Software"), to deal
 * in the Software without restriction, including without limitation the rights
 * to use, copy, modify, merge, publish, distribute, sublicense, and/or sell
 * copies of the Software, and to permit persons to whom the Software is
 * furnished to do so, subject to the following conditions:
 *
 * The above copyright notice and this permission notice shall be included in
 * all copies or substantial portions of the Software.
 *
 * THE SOFTWARE IS PROVIDED "AS IS", WITHOUT WARRANTY OF ANY KIND, EXPRESS OR
 * IMPLIED, INCLUDING BUT NOT LIMITED TO THE WARRANTIES OF MERCHANTABILITY,
 * FITNESS FOR A PARTICULAR PURPOSE AND NONINFRINGEMENT. IN NO EVENT SHALL THE
 * AUTHORS OR COPYRIGHT HOLDERS BE LIABLE FOR ANY CLAIM, DAMAGES OR OTHER
 * LIABILITY, WHETHER IN AN ACTION OF CONTRACT, TORT OR OTHERWISE, ARISING FROM,
 * OUT OF OR IN CONNECTION WITH THE SOFTWARE OR THE USE OR OTHER DEALINGS IN
 * THE SOFTWARE.
 */
#ifndef OBJFLASH_H_
#define OBJFLASH_H_

#include "py/mpstate.h"
#include "py/runtime.h"
#include "py/mphal.h"


extern const mp_obj_type_t flash_type;

typedef struct {
    mp_obj_base_t base;
    size_t        block_size;
    size_t        start;
    size_t        len;
} flash_obj_t;

#endif  // OBJFLASH_H_
```

## src/fatfs_port.c
```c
// SPDX-License-Identifier: MIT
// get_fattime() for ameba-rtos: feeds oofatfs mtime/ctime stamps from the
// same hardware RTC that backs machine.RTC (see machine_rtc.c). Lazily
// initializes the RTC on first call so timestamps advance even if the user
// never touches machine.RTC -- matches ports/esp32 and ports/rp2, which
// source get_fattime() from an always-running clock rather than requiring
// the user to set one up first.

#include "lib/oofatfs/ff.h"
#include "shared/timeutils/timeutils.h"

#include "rtc_api.h"

DWORD get_fattime(void) {
    if (!rtc_isenabled()) {
        rtc_init();
    }
    timeutils_struct_time_t tm;
    timeutils_seconds_since_epoch_to_struct_time(rtc_read(), &tm);
    return ((DWORD)(tm.tm_year - 1980) << 25) | ((DWORD)tm.tm_mon << 21) | ((DWORD)tm.tm_mday << 16) |
           ((DWORD)tm.tm_hour << 11) | ((DWORD)tm.tm_min << 5) | ((DWORD)tm.tm_sec >> 1);
}
```

## src/machine_adc.c
```c
// SPDX-License-Identifier: MIT
// machine.ADC port implementation for ameba-rtos.
//
// INCLUDEFILE — included by extmod/machine_adc.c via
// MICROPY_PY_MACHINE_ADC_INCLUDEFILE.  Defines machine_adc_obj_t and all
// mp_machine_adc_* functions required by the extmod framework.
//
// 8 channels (CH0-CH7) via the SDK's AD_0..AD_7 PinName aliases. On
// AmebaDplus, AD_7 is VBAT_MEAS, an internal channel with no external pin
// (see the CONFIG_AMEBADPLUS guard in mp_machine_adc_deinit below); on other
// SoCs all 8 channels are normal external pins.

// Must be defined (can be empty) for the extmod locals dict.
#define MICROPY_PY_MACHINE_ADC_CLASS_CONSTANTS

#include "analogin_api.h"
#include "ameba_soc.h"       // Pinmux_Config, PINMUX_FUNCTION_GPIO

// ---------------------------------------------------------------------------
// Pin → channel mapping (mirrors SDK's PinMap_ADC[])
// ---------------------------------------------------------------------------
typedef struct {
    PinName pin;
    uint8_t channel;
} adc_pin_map_t;

// AD_0..AD_7 are the SDK's own PinName aliases for the real hardware pins
// (see each SoC's PinNames.h / analogin_api.c PinMap_ADC[]), so this table
// tracks per-SoC pin assignments automatically instead of hardcoding them.
static const adc_pin_map_t adc_pin_table[] = {
    {AD_0, 0},
    {AD_1, 1},
    {AD_2, 2},
    {AD_3, 3},
    {AD_4, 4},
    {AD_5, 5},
    {AD_6, 6},
    {AD_7, 7},          // AD_7 == VBAT_MEAS (internal) on AmebaDplus
    {NC, 0xFF},         // terminator
};

#define ADC_PIN_COUNT 8       // AD_0..AD_7 (AD_7 == VBAT_MEAS on AmebaDplus)

static int8_t adc_pin_to_channel(PinName pin) {
    for (const adc_pin_map_t *p = adc_pin_table; p->pin != NC; p++) {
        if (p->pin == pin) {
            return (int8_t)p->channel;
        }
    }
    return -1;
}

static PinName adc_channel_to_pin(uint8_t channel) {
    for (const adc_pin_map_t *p = adc_pin_table; p->pin != NC; p++) {
        if (p->channel == channel) {
            return p->pin;
        }
    }
    return NC;
}

// ---------------------------------------------------------------------------
// Object type
// ---------------------------------------------------------------------------
typedef struct _machine_adc_obj_t {
    mp_obj_base_t base;
    analogin_t adc;          // mbed HAL object, embedded
    uint8_t    channel;      // 0-7
    PinName    pin;
    bool       initialized;
} machine_adc_obj_t;

// ---------------------------------------------------------------------------
// print
// ---------------------------------------------------------------------------
static void mp_machine_adc_print(const mp_print_t *print, mp_obj_t self_in, mp_print_kind_t kind) {
    (void)kind;
    machine_adc_obj_t *self = MP_OBJ_TO_PTR(self_in);
    mp_printf(print, "ADC(%u)", self->channel);
}

// ---------------------------------------------------------------------------
// make_new — ADC(pin) or ADC(channel)
// ---------------------------------------------------------------------------
static mp_obj_t mp_machine_adc_make_new(const mp_obj_type_t *type,
    size_t n_args, size_t n_kw, const mp_obj_t *args) {

    mp_arg_check_num(n_args, n_kw, 1, 1, false);
    mp_obj_t source = args[0];

    PinName pin = NC;
    uint8_t channel;
    int8_t ch;

    if (mp_obj_is_int(source)) {
        // Integer: ADC(channel), e.g. ADC(0) → AD_0 = PB19
        mp_int_t c = mp_obj_get_int(source);
        if (c < 0 || c > 7) {
            mp_raise_ValueError(MP_ERROR_TEXT("ADC channel out of range"));
        }
        channel = (uint8_t)c;
        pin = adc_channel_to_pin(channel);
        if (pin == NC) {
            mp_raise_ValueError(MP_ERROR_TEXT("ADC channel out of range"));
        }
    } else {
        // Pin object / pin name: ADC(Pin("PB19")), ADC("PB19").
        // mp_hal_pin_resolve validates the type via machine_pin_find and
        // raises a clean ValueError on a non-pin argument, instead of
        // blindly dereferencing it as a pointer (undefined behaviour).
        pin = mp_hal_pin_resolve(source);
        ch = adc_pin_to_channel(pin);
        if (ch < 0) {
            mp_raise_ValueError(MP_ERROR_TEXT("Pin doesn't have ADC capabilities"));
        }
        channel = (uint8_t)ch;
    }

    // Dynamic allocation.
    machine_adc_obj_t *self = mp_obj_malloc(machine_adc_obj_t, &machine_adc_type);
    self->channel = channel;
    self->pin = pin;

    // analogin_init handles pinmux and ADC configuration internally.
    // Unlike SPI/UART/I2C/PWM, the SDK sets obj->adc_idx automatically
    // via pinmap_peripheral() — no need to pre-set it.
    analogin_init(&self->adc, pin);
    self->initialized = true;

    return MP_OBJ_FROM_PTR(self);
}

// ---------------------------------------------------------------------------
// read_u16 — 0..65535
// ---------------------------------------------------------------------------
static mp_int_t mp_machine_adc_read_u16(machine_adc_obj_t *self) {
    if (!self->initialized) {
        return 0;
    }
    // The hardware ADC is 12-bit; analogin_read_u16() returns the raw 12-bit
    // value (0-4095).  Scale to 16-bit (0-65535) using the same expansion as
    // the RP2 port: upper bits = raw, lower bits = interpolated copy.
    uint16_t raw = analogin_read_u16(&self->adc);
    const uint32_t bits = 12;
    return (mp_int_t)((raw << (16 - bits)) | (raw >> (2 * bits - 16)));
}

// ---------------------------------------------------------------------------
// deinit
// ---------------------------------------------------------------------------
static void mp_machine_adc_deinit(machine_adc_obj_t *self) {
    if (self->initialized) {
        analogin_deinit(&self->adc);
        #if defined(CONFIG_AMEBADPLUS)
        // VBAT_MEAS is an internal measurement channel with no external pin;
        // analogin_init skips Pinmux_Config for it, so we skip restoration too.
        if (self->pin != VBAT_MEAS) {
            Pinmux_Config((u8)self->pin, PINMUX_FUNCTION_GPIO);
        }
        #else
        Pinmux_Config((u8)self->pin, PINMUX_FUNCTION_GPIO);
        #endif
        self->initialized = false;
    }
}
```

## src/machine_bitstream.c
```c
// SPDX-License-Identifier: MIT
// machine.bitstream for ameba-rtos.
//
// Two-tier dispatch, AmebaDplus (RTL8721Dx) only:
//   Path A: LEDC hardware DMA mode      (len % 3 == 0, LED count in range, GDMA channel available)
//   Path C: software SysTick bit-bang   (everything else, incl. no GDMA channel free)
//
// Other SoCs (e.g. AmebaGreen2) always use Path C: their LEDC-equivalent
// block uses a completely different, incompatible API (see the
// CONFIG_AMEBADPLUS guard below) that hasn't been ported yet.
//
// LEDC is a WS2812-shaped hardware block: LEDC_DATA_REG masks to 24 valid
// bits (LEDC_MASK_DATA = 0x00FFFFFF) with no register to change that width.
// It can only accelerate 3-byte-per-unit (RGB) transfers; RGBW (4 bytes/LED)
// and any other non-multiple-of-3 buffer falls back to the original
// software path, unchanged.
//
// There used to be a "Path B" (LEDC hardware, CPU-polled FIFO refill instead
// of DMA) for when no GDMA channel was free. It's removed: LEDC_SetTransferMode()
// unconditionally enables LEDC_BIT_FIFO_CPUREQ_INT_EN for CPU mode, but nothing
// in this driver registers an NVIC handler for LEDC_IRQ or otherwise services
// that interrupt, and on hardware the transfer stalled after the first FIFO
// burst (observed: only a few LEDs' worth of waveform, then a timeout).
// The official raw_ledc_ws2812 example only ever exercises DMA mode too
// (LEDC_MODE is hardcoded to LEDC_DMA_MODE), so CPU mode was never a
// vendor-validated path for this use case. If no GDMA channel is free, we
// now go straight to the software fallback instead of debugging a second
// hardware mode.
//
// Path A never disables global interrupts -- LEDC's hardware state machine
// generates the T0H/T0L/T1H/T1L pulses autonomously; software only supplies
// data via DMA and busy-waits on the raw LEDC_LED_INT_STS_REG completion bit
// (no ISR registration needed for that part).
//
// Path C (software bit-bang) is unchanged from the original implementation:
// timing uses the SysTick counter (CPU clock = 240 MHz).  The RTL8721Dx KM4
// does not implement DWT CYCCNT (DWT_CTRL.NOCYCCNT == 1), so SysTick is the
// only available cycle counter.  GPIO_DR is written directly to reduce each
// toggle to a single read-modify-write on the LSYS APB4 bus.

#include "py/runtime.h"
#include "py/mphal.h"
#include "extmod/modmachine.h"
#include "ameba_soc.h"

#if MICROPY_PY_MACHINE_BITSTREAM

#define NS_CYCLES_OVERHEAD (0)

// LEDC_SetLEDNum() asserts Num <= LEDC_MAX_LED_NUM (1024) -- this is the
// real hardware ceiling for the LEDC path, smaller than LEDC_MAX_DATA_LENGTH
// (8192, which only bounds LEDC_SetTotalLength). Exceeding it must fall
// back to software rather than trip that assert and crash the device.
#define BITSTREAM_LEDC_MAX_LEDS (1024)

// ---------------------------------------------------------------------------
// Path C: original software SysTick bit-bang (unchanged behavior).
// ---------------------------------------------------------------------------
static void bitstream_software_fallback(mp_hal_pin_obj_t pin, uint32_t *timing_ns,
    const uint8_t *buf, size_t len) {

    // Convert ns to SysTick ticks (rp2 formula: 3 * OH removed from period).
    uint32_t fcpu_mhz = SystemCoreClock / 1000000;
    for (size_t i = 0; i < 4; ++i) {
        timing_ns[i] = fcpu_mhz * timing_ns[i] / 1000;
        if (timing_ns[i] > (2 * NS_CYCLES_OVERHEAD)) {
            timing_ns[i] -= NS_CYCLES_OVERHEAD;
        } else {
            timing_ns[i] = 0;
        }
        if (i % 2 == 1) {
            timing_ns[i] += timing_ns[i - 1] - NS_CYCLES_OVERHEAD;
        }
    }

    // Explicitly reclaim the pad for GPIO before driving GPIO_DR directly.
    // If Path A (LEDC) ran on this same pin earlier, its Pinmux_Config(pin,
    // PINMUX_FUNCTION_LEDC) call left the pad wired to LEDC; mp_hal_pin_output()
    // won't undo that on its own, since mp_hal_pin_gpio() only runs gpio_init()
    // (which is what calls Pinmux_Config(pin, PINMUX_FUNCTION_GPIO)) once per
    // pin, the first time it's ever used -- it has no way to know the pad's
    // mux function was changed out from under it by a raw SDK call. Without
    // this, GPIO_DR writes below reach a GPIO peripheral that no longer owns
    // the pad, producing no waveform at all.
    Pinmux_Config((u8)pin, PINMUX_FUNCTION_GPIO);

    // Configure pin as output before the atomic section so lazy gpio_init()
    // (which takes an RTOS lock) does not run with IRQs disabled.
    mp_hal_pin_output(pin);

    // Direct GPIO_DR access, bypassing the HAL chain (~400 ns on LSYS APB4).
    // PinName: bit[5] = port (0 = A, 1 = B), bits[4:0] = pin number.
    // GPIO_TypeDef.PORT is declared as an array (PORT[1]) on AmebaDplus but as
    // a plain struct member on AmebaGreen2 -- same field, different C shape.
    uint32_t bit_mask = (1u << (pin & 0x1Fu));
    #if defined(CONFIG_AMEBADPLUS)
    volatile uint32_t *gpio_dr = ((pin >> 5) == 0)
        ? &GPIOA_BASE->PORT[0].GPIO_DR
        : &GPIOB_BASE->PORT[0].GPIO_DR;
    #else
    volatile uint32_t *gpio_dr = ((pin >> 5) == 0)
        ? &GPIOA_BASE->PORT.GPIO_DR
        : &GPIOB_BASE->PORT.GPIO_DR;
    #endif

    mp_uint_t atomic_state = MICROPY_BEGIN_ATOMIC_SECTION();

    for (size_t i = 0; i < len; ++i) {
        uint8_t b = buf[i];
        for (size_t j = 0; j < 8; ++j) {
            uint32_t *t = &timing_ns[b >> 6 & 2];
            uint32_t start = SysTick->VAL;
            *gpio_dr |= bit_mask;
            while ((start - SysTick->VAL) < t[0]) {}
            *gpio_dr &= ~bit_mask;
            b <<= 1;
            while ((start - SysTick->VAL) < t[1]) {}
        }
    }

    MICROPY_END_ATOMIC_SECTION(atomic_state);
}

// Path A (LEDC hardware) is AmebaDplus-specific. AmebaGreen2 has a different,
// incompatible LEDC block (ameba_ledc_pro.h -- no overlap at all with the
// LEDC_Init()/LEDC_InitTypeDef/LEDC_DMA_MODE API used below) that would need
// its own from-scratch port, not a drop-in adaptation. Until/unless that's
// done, other SoCs always use the software fallback (Path C).
#if defined(CONFIG_AMEBADPLUS)

// ---------------------------------------------------------------------------
// Shared helper: pack a 3*n_leds-byte buffer into n_leds cache-line-aligned
// 24-in-32-bit words for the LEDC FIFO.  Returns NULL on allocation failure
// (caller must fall back to Path C).  *out_raw / *out_raw_size let the
// caller free the exact block later with m_del.
// ---------------------------------------------------------------------------
static uint32_t *bitstream_ledc_pack(const uint8_t *buf, size_t n_leds,
    uint8_t **out_raw, size_t *out_raw_size) {
    size_t raw_size = n_leds * sizeof(uint32_t) + CACHE_LINE_SIZE;
    uint8_t *raw = m_new(uint8_t, raw_size);
    if (raw == NULL) {
        return NULL;
    }
    uint32_t *staging = (uint32_t *)(((uintptr_t)raw + CACHE_LINE_SIZE - 1)
        & ~(uintptr_t)(CACHE_LINE_SIZE - 1));

    for (size_t i = 0; i < n_leds; ++i) {
        staging[i] = ((uint32_t)buf[i * 3] << 16)
                   | ((uint32_t)buf[i * 3 + 1] << 8)
                   | buf[i * 3 + 2];
    }
    // Match the official raw_ledc_ws2812 example, which uses CleanInvalidate
    // (not Clean-only) on the DMA source buffer before starting the transfer.
    DCache_CleanInvalidate((u32)staging, (u32)(n_leds * sizeof(uint32_t)));

    *out_raw = raw;
    *out_raw_size = raw_size;
    return staging;
}

// ---------------------------------------------------------------------------
// Shared helper: configure LEDC pinmux + timing + counts for this transfer.
//
// Uses the full LEDC_StructInit() + LEDC_Init() flow rather than poking
// individual T0H/T0L registers. This matters because LEDC_Init() also loads
// reset_ns / wait_data_time_ns / wait_time0/1 (which tell the state machine
// when a frame ends) and calls LEDC_INTConfig(LEDC_INT_EXT_EN) at the end.
// Without those, LEDC_BIT_LED_TRANS_FINISH_INT is never raised and the
// completion busy-wait spins forever (observed on hardware as a full hang).
//
// LEDC's counter fields tick every 25 ns (40 MHz IP clock). The struct's
// t0h_ns/etc. fields are misleadingly named -- they hold raw tick counts, so
// timing_ns[] (in nanoseconds, from neopixel) must be divided by 25, exactly
// as the official example does via its NS2VAL() macro.
// ---------------------------------------------------------------------------
#define BITSTREAM_LEDC_NS_PER_TICK (25)

static void bitstream_ledc_configure(mp_hal_pin_obj_t pin, uint32_t *timing_ns,
    size_t n_leds) {
    RCC_PeriphClockCmd(APBPeriph_LEDC, APBPeriph_LEDC_CLOCK, ENABLE);
    Pinmux_Config((u8)pin, PINMUX_FUNCTION_LEDC);

    LEDC_InitTypeDef init;
    LEDC_StructInit(&init);
    init.t0h_ns = timing_ns[0] / BITSTREAM_LEDC_NS_PER_TICK;
    init.t0l_ns = timing_ns[1] / BITSTREAM_LEDC_NS_PER_TICK;
    init.t1h_ns = timing_ns[2] / BITSTREAM_LEDC_NS_PER_TICK;
    init.t1l_ns = timing_ns[3] / BITSTREAM_LEDC_NS_PER_TICK;
    init.led_count = (u32)n_leds;
    init.data_length = (u32)n_leds;
    init.ledc_trans_mode = LEDC_DMA_MODE;
    // LEDC_StructInit() defaults wait_time0_en to ENABLE with a 6us gap
    // inserted between every pair of LED words (LEDC_WAIT_TIME0_CTRL_REG).
    // That is a generic "inter-package" spacing feature of the IP, not part
    // of the WS2812 protocol, and neither the software fallback path nor any
    // other bitstream backend produces it -- disable it so pixels stream
    // back-to-back with no gap, matching the intended bit-exact waveform.
    init.wait_time0_en = DISABLE;
    LEDC_Init(LEDC_DEV, &init);
}

// Upper bound on how long to wait for LEDC_BIT_LED_TRANS_FINISH_INT before
// giving up. A full 1024-LED frame is ~1.3 ms of bit time plus the reset
// window, so 100 ms is generously above any legitimate transfer while still
// guaranteeing the call returns instead of hanging the board if the hardware
// never signals completion (which is exactly the failure mode a missing
// LEDC_Init config caused before this was hardened).
#define BITSTREAM_LEDC_TIMEOUT_US (100000)

// Poll the transfer-finish flag with a timeout. Returns true on completion,
// false on timeout.
static bool bitstream_ledc_wait_done(void) {
    mp_uint_t start = mp_hal_ticks_us();
    while (!(LEDC_GetINT(LEDC_DEV) & LEDC_BIT_LED_TRANS_FINISH_INT)) {
        if (mp_hal_ticks_us() - start > BITSTREAM_LEDC_TIMEOUT_US) {
            return false;
        }
    }
    return true;
}

// Minimal GDMA transfer-complete ISR: just acknowledge the interrupt. The
// actual completion is detected by polling LEDC's TRANS_FINISH flag, but
// GDMA_Init() enables the channel's interrupt and GDMA_ChnlAlloc() registers
// this handler in the NVIC -- a NULL handler here would jump to address 0 and
// fault when the transfer-complete interrupt fires (this was the original hang).
static u8 s_ledc_dma_ch;
static u32 bitstream_ledc_dma_irq(void *param) {
    (void)param;
    GDMA_ClearINT(0, s_ledc_dma_ch);
    return 0;
}

// ---------------------------------------------------------------------------
// Path A: LEDC hardware DMA mode.  Takes a GDMA channel already allocated by
// the caller.  GDMA struct fields (Msize, IsrType) mirror the official
// raw_ledc_ws2812 example -- a zero-filled struct left the channel
// misconfigured and hung GDMA_Init().
// ---------------------------------------------------------------------------
static void bitstream_ledc_dma(uint32_t *staging, size_t n_leds, u8 ch) {
    // Match the example: FIFO trigger level 15 -> 16-word bursts.
    LEDC_SetFIFOLevel(LEDC_DEV, 15);

    GDMA_InitTypeDef gdma = {0};
    gdma.GDMA_Index = 0;
    gdma.GDMA_ChNum = ch;
    gdma.GDMA_DIR = TTFCMemToPeri_PerCtrl;
    gdma.GDMA_DstHandshakeInterface = GDMA_HANDSHAKE_INTERFACE_LEDC_TX;
    gdma.GDMA_IsrType = (BlockType | TransferType | ErrType);
    gdma.GDMA_SrcAddr = (u32)staging;
    gdma.GDMA_DstAddr = (u32)&LEDC_DEV->LEDC_DATA_REG;
    gdma.GDMA_SrcInc = IncType;
    gdma.GDMA_DstInc = NoChange;
    gdma.GDMA_SrcMsize = MsizeSixteen;
    gdma.GDMA_DstMsize = MsizeSixteen;
    gdma.GDMA_SrcDataWidth = TrWidthFourBytes;
    gdma.GDMA_DstDataWidth = TrWidthFourBytes;
    GDMA_Init(0, ch, &gdma);

    // Enable GDMA before LEDC: the transfer is peripheral-controlled
    // handshake, so GDMA sits idle until LEDC's FIFO actually requests a
    // word.  Matches the official raw_ledc_ws2812 example's ordering.
    GDMA_Cmd(0, ch, ENABLE);
    LEDC_Cmd(LEDC_DEV, ENABLE);

    bool ok = bitstream_ledc_wait_done();

    GDMA_Cmd(0, ch, DISABLE);
    GDMA_ChnlFree(0, ch);
    if (!ok) {
        // Reset the peripheral so a timed-out transfer doesn't leave it
        // half-configured for the next call.
        LEDC_SoftReset(LEDC_DEV);
    }
}

#endif // CONFIG_AMEBADPLUS

// ---------------------------------------------------------------------------
// Entry point (upstream extmod contract: synchronous, blocks until sent).
// ---------------------------------------------------------------------------
void machine_bitstream_high_low(mp_hal_pin_obj_t pin, uint32_t *timing_ns,
    const uint8_t *buf, size_t len) {

    if (len == 0) {
        return;
    }

    #if defined(CONFIG_AMEBADPLUS)
    size_t n_leds = len / 3;
    if ((len % 3) == 0 && n_leds > 0 && n_leds <= BITSTREAM_LEDC_MAX_LEDS) {
        // Grab the GDMA channel before packing: no point copying the buffer
        // if there's no channel free and we're about to fall back anyway.
        u8 ch = GDMA_ChnlAlloc(0, (IRQ_FUN)bitstream_ledc_dma_irq, 0, 4);
        if (ch != 0xFF) {
            uint8_t *raw;
            size_t raw_size;
            uint32_t *staging = bitstream_ledc_pack(buf, n_leds, &raw, &raw_size);
            if (staging != NULL) {
                s_ledc_dma_ch = ch;
                bitstream_ledc_configure(pin, timing_ns, n_leds);
                bitstream_ledc_dma(staging, n_leds, ch);
                m_del(uint8_t, raw, raw_size);
                return;
            }
            // m_new failed -- free the channel and fall through to software.
            GDMA_ChnlFree(0, ch);
        }
        // No GDMA channel free -- fall through to the software path below.
    }
    #endif // CONFIG_AMEBADPLUS

    bitstream_software_fallback(pin, timing_ns, buf, len);
}

#endif // MICROPY_PY_MACHINE_BITSTREAM
```

## src/machine_i2c.c
```c
// SPDX-License-Identifier: MIT
// machine.I2C (hardware master) for ameba-rtos (AmebaDplus).
//
// Implements the mp_machine_i2c_p_t protocol via transfer_single, using the
// mbed HAL i2c_write/i2c_read for single-buffer transfers.  extmod's
// mp_machine_i2c_transfer_adaptor handles multi-buffer consolidation and
// the readfrom_mem/writeto_mem combined-transaction fallback.
//
// The Ameba SDK i2c_start/i2c_stop are no-ops (the HAL manages START/STOP
// internally inside i2c_write/i2c_read).

#include "py/runtime.h"
#include "py/mphal.h"
#include "py/mperrno.h"
#include "extmod/modmachine.h"

#include "i2c_api.h"
#include "PinNames.h"
#include "ameba_soc.h"   // Pinmux_Config(), PINMUX_FUNCTION_GPIO

// i2c_write_timeout() is defined in the SDK's hal/src/i2c_api.c but NOT
// declared in hal/include/i2c_api.h.  We need it for zero-length writes
// (scan probe): the non-timeout i2c_write() with len=0 is a no-op on the
// bus (I2C_MasterWrite loop doesn't execute), returning 0 unconditionally,
// which makes scan() see every addressed as ACKed (false positives).
// i2c_write_timeout() properly calls I2C_MasterSendNullData_TimeOut() which
// sends START + address + STOP and detects ACK/NACK.
//
// i2c_read_timeout()/i2c_write_timeout() are also used for the actual data
// phases: the non-timeout i2c_read()/i2c_write() call I2C_MasterRead()/
// I2C_MasterWrite(), which busy-wait on the bus with NO upper bound.  A
// slave that holds SCL/SDA low (e.g. mid-transaction, or wired wrong) then
// hangs the interpreter forever.  The _TimeOut variants bound the wait and
// reset+recover the peripheral on failure, returning a short count so we can
// surface -EIO/-ETIMEDOUT instead of locking up.
extern int i2c_write_timeout(i2c_t *obj, int address, char *data, int length, int stop, int timeout_ms);
extern int i2c_read_timeout(i2c_t *obj, int address, char *data, int length, int stop, int timeout_ms);

#define I2C_ID_COUNT       (2)
#define DEFAULT_I2C_FREQ   (400000)
// Per-transfer timeout (ms) when the user does not pass timeout=.  Generous
// enough for a full 100-byte buffer at 100 kHz (~10 ms) yet short enough that
// a stuck bus surfaces an error instead of an unbounded hang.
#define DEFAULT_I2C_TIMEOUT_MS (1000)

typedef struct _machine_i2c_obj_t {
    mp_obj_base_t base;
    i2c_t    i2c;          // mbed HAL object, embedded
    uint8_t  i2c_id;       // 0 or 1
    PinName  scl;
    PinName  sda;
    uint32_t freq;
    uint32_t timeout;      // per-transfer timeout in ms
    bool     initialized;
} machine_i2c_obj_t;

// Non-static: machine_i2c_target.c reads .initialized for master/slave mutex.
machine_i2c_obj_t machine_i2c_obj[I2C_ID_COUNT];

// ---- Pin parse: int PinName, or string "PAx"/"PA_x"/"PBx"/"PB_x" ----

static PinName machine_i2c_get_pin(mp_obj_t obj) {
    if (mp_obj_is_int(obj)) {
        return (PinName)mp_obj_get_int(obj);
    }
    if (mp_obj_is_str(obj)) {
        size_t len;
        const char *s = mp_obj_str_get_data(obj, &len);
        if (len >= 3 && s[0] == 'P' && (s[1] == 'A' || s[1] == 'B')) {
            size_t i = 2;
            if (s[i] == '_') {
                i++;
            }
            int num = 0;
            bool has_digit = false;
            for (; i < len; i++) {
                if (s[i] < '0' || s[i] > '9') {
                    has_digit = false;
                    break;
                }
                num = num * 10 + (s[i] - '0');
                has_digit = true;
            }
            if (has_digit && num >= 0 && num <= 31) {
                int base = (s[1] == 'B') ? (int)PB_0 : (int)PA_0;
                return (PinName)(base + num);
            }
        }
    }
    mp_raise_ValueError(MP_ERROR_TEXT("invalid I2C pin"));
}

// ---- print ----

static void machine_i2c_print(const mp_print_t *print, mp_obj_t self_in, mp_print_kind_t kind) {
    (void)kind;
    machine_i2c_obj_t *self = MP_OBJ_TO_PTR(self_in);
    const char *sclp = (self->scl < PB_0) ? "PA" : "PB";
    int scln = (self->scl < PB_0) ? (int)self->scl : (int)(self->scl - PB_0);
    const char *sdap = (self->sda < PB_0) ? "PA" : "PB";
    int sdan = (self->sda < PB_0) ? (int)self->sda : (int)(self->sda - PB_0);
    mp_printf(print, "I2C(%u, freq=%u, scl=%s%d, sda=%s%d)",
        self->i2c_id, self->freq, sclp, scln, sdap, sdan);
}

// ---- init_helper: (re)configure the peripheral ----

static void mp_machine_i2c_init_helper(machine_i2c_obj_t *self,
    size_t n_args, const mp_obj_t *pos_args, mp_map_t *kw_args) {

    enum { ARG_freq, ARG_scl, ARG_sda, ARG_timeout };
    static const mp_arg_t allowed_args[] = {
        { MP_QSTR_freq,    MP_ARG_INT, {.u_int = -1} },
        { MP_QSTR_scl,     MP_ARG_OBJ | MP_ARG_KW_ONLY, {.u_obj = MP_OBJ_NULL} },
        { MP_QSTR_sda,     MP_ARG_OBJ | MP_ARG_KW_ONLY, {.u_obj = MP_OBJ_NULL} },
        { MP_QSTR_timeout, MP_ARG_KW_ONLY | MP_ARG_INT, {.u_int = -1} },
    };
    mp_arg_val_t args[MP_ARRAY_SIZE(allowed_args)];
    mp_arg_parse_all(n_args, pos_args, kw_args, MP_ARRAY_SIZE(allowed_args), allowed_args, args);

    // First-time defaults (preserve existing values on re-init).
    if (!self->initialized) {
        self->freq = DEFAULT_I2C_FREQ;
        self->timeout = DEFAULT_I2C_TIMEOUT_MS;
        // scl/sda have no board-default; they must be set by the user the
        // first time, so leave them uninitialised — if they are still NULL
        // after parsing we raise ValueError below.
        self->scl = (PinName)0;
        self->sda = (PinName)0;
    }

    if (args[ARG_freq].u_int > 0) {
        self->freq = (uint32_t)args[ARG_freq].u_int;
    }
    if (args[ARG_scl].u_obj != MP_OBJ_NULL) {
        self->scl = machine_i2c_get_pin(args[ARG_scl].u_obj);
    }
    if (args[ARG_sda].u_obj != MP_OBJ_NULL) {
        self->sda = machine_i2c_get_pin(args[ARG_sda].u_obj);
    }
    if (args[ARG_timeout].u_int > 0) {
        self->timeout = (uint32_t)args[ARG_timeout].u_int;
    }

    // Both pins must be assigned before init.
    if (self->scl == (PinName)0 || self->sda == (PinName)0) {
        mp_raise_ValueError(MP_ERROR_TEXT("scl and sda must be specified"));
    }

    // Tear down a previous configuration before re-init.
    if (self->initialized) {
        // i2c_reset() only disables the peripheral (I2C_Cmd(DISABLE)).
        // The pinmux will be re-assigned by i2c_init() below.
        i2c_reset(&self->i2c);
        self->initialized = false;
    }

    // The Ameba HAL indexes I2C_DEV_TABLE[] by obj->i2c_idx — set it BEFORE
    // i2c_init (same trap as SPI's spi_idx and UART's uart_idx).
    self->i2c.i2c_idx = self->i2c_id;

    // i2c_init handles pinmux and pull-up internally:
    //   I2C0: Pinmux_Config(sda, PINMUX_FUNCTION_I2C0_SDA) + PAD_PullCtrl(UP)
    //         Pinmux_Config(scl, PINMUX_FUNCTION_I2C0_SCL) + PAD_PullCtrl(UP)
    //   I2C1: PINMUX_FUNCTION_I2C1_SDA / I2C1_SCL
    i2c_init(&self->i2c, (PinName)self->sda, (PinName)self->scl);
    i2c_frequency(&self->i2c, (int)self->freq);

    // Work around an Ameba HAL address-cache bug: i2c_api.c keeps the last
    // target address in a file-static (i2c_target_addr[]) and only reloads the
    // hardware IC_TAR register when the address *changes*.  i2c_init() above
    // resets IC_TAR but leaves that static stale, so the first transfer to an
    // address that a previous I2C object already used would skip the reload and
    // address the wrong slave (TX abort: 7B_ADDR_NOACK -> EIO).  Prime the cache
    // with an invalid 7-bit address (0xFF) so the first real transfer to any
    // 0x00-0x7F address is guaranteed to miss the cache and reload IC_TAR.  This
    // is a generic fix (any device/address), not specific to any slave; the cost
    // is one harmless zero-length probe to reserved address 0x7F at construction.
    i2c_write_timeout(&self->i2c, 0xFF, NULL, 0, 1, 1);

    self->initialized = true;
}

// ---- make_new ----

static mp_obj_t machine_i2c_make_new(const mp_obj_type_t *type,
    size_t n_args, size_t n_kw, const mp_obj_t *args) {

    mp_arg_check_num(n_args, n_kw, 1, MP_OBJ_FUN_ARGS_MAX, true);
    mp_int_t i2c_id = mp_obj_get_int(args[0]);

    if (i2c_id < 0 || i2c_id >= I2C_ID_COUNT) {
        mp_raise_msg_varg(&mp_type_ValueError,
            MP_ERROR_TEXT("I2C(%d) doesn't exist"), (int)i2c_id);
    }

    machine_i2c_obj_t *self = &machine_i2c_obj[i2c_id];
    self->base.type = type;
    self->i2c_id = (uint8_t)i2c_id;

    mp_map_t kw_args;
    mp_map_init_fixed_table(&kw_args, n_kw, args + n_args);
    mp_machine_i2c_init_helper(self, n_args - 1, args + 1, &kw_args);

    return MP_OBJ_FROM_PTR(self);
}

// ---- protocol: init / deinit / transfer ----

static void machine_i2c_init(mp_obj_base_t *self_in,
    size_t n_args, const mp_obj_t *pos_args, mp_map_t *kw_args) {
    machine_i2c_obj_t *self = (machine_i2c_obj_t *)self_in;
    mp_machine_i2c_init_helper(self, n_args, pos_args, kw_args);
}

// The SDK's i2c_reset() only disables the peripheral (I2C_Cmd(DISABLE));
// it leaves the two pads muxed to I2C.  Restore them to GPIO so they can
// be reused as machine.Pin.  (Note: i2c_init handles pinmux assignment,
// so a re-init via init_helper → i2c_reset + i2c_init is also safe.)
//
// This function is static; it is called from both machine_i2c_deinit and
// the soft-reset deinit_all path.
static void machine_i2c_pins_release(machine_i2c_obj_t *self) {
    Pinmux_Config((u8)self->scl, PINMUX_FUNCTION_GPIO);
    Pinmux_Config((u8)self->sda, PINMUX_FUNCTION_GPIO);
}

static void machine_i2c_deinit(mp_obj_base_t *self_in) {
    machine_i2c_obj_t *self = (machine_i2c_obj_t *)self_in;
    if (self->initialized) {
        i2c_reset(&self->i2c);
        machine_i2c_pins_release(self);
        self->initialized = false;
    }
}

// Full-duplex, blocking, single-buffer transfer.  extmod's
// mp_machine_i2c_transfer_adaptor merges multi-buffer transfers
// (e.g. writeto_mem → write-address + write-data) before calling this.
//
// Note: the SDK's i2c_read()/i2c_write() ignore the `stop` parameter and
// always send STOP after each transfer.  Combined transactions (repeated
// START between write and read phases) are NOT supported at the hardware
// level in this implementation; extmod falls back to two separate
// transactions for readfrom_mem/writeto_mem, which works with most I2C
// devices.  Upgrade to i2c_repeatread() + transfer_supports_write1 if a
// device requires true repeated START.
static int machine_i2c_transfer_single(mp_obj_base_t *self_in,
    uint16_t addr, size_t len, uint8_t *buf, unsigned int flags) {

    machine_i2c_obj_t *self = (machine_i2c_obj_t *)self_in;
    if (!self->initialized) {
        return -MP_EINVAL;
    }

    bool nostop = !(flags & MP_MACHINE_I2C_FLAG_STOP);
    int ret;

    if (flags & MP_MACHINE_I2C_FLAG_READ) {
        ret = i2c_read_timeout(&self->i2c, (int)addr, (char *)buf, (int)len, (int)(!nostop), (int)self->timeout);
        if (ret != (int)len) {
            return -MP_EIO;
        }
        return (int)len;
    } else {
        if (len == 0) {
            // Zero-length write (used by scan() to probe a 7-bit address).
            // i2c_write() with len=0 does nothing on the bus (the HAL
            // I2C_MasterWrite loop doesn't execute), so it always returns
            // 0 regardless of whether any slave ACKed, causing scan() to
            // report false positives for every address 0x08-0x77.
            // Use i2c_write_timeout which calls
            // I2C_MasterSendNullData_TimeOut to actually send
            // START + address + STOP and detect ACK/NACK.
            // The timeout of 100 ms is generous for a single probe.
            ret = i2c_write_timeout(&self->i2c, (int)addr, NULL, 0, (int)(!nostop), 100);
            return (ret < 0) ? -MP_ENODEV : 0;
        }
        ret = i2c_write_timeout(&self->i2c, (int)addr, (char *)buf, (int)len, (int)(!nostop), (int)self->timeout);
        if (ret != (int)len) {
            return -MP_EIO;
        }
        return (int)len;
    }
}

static const mp_machine_i2c_p_t machine_i2c_p = {
    .init = machine_i2c_init,
    .transfer = mp_machine_i2c_transfer_adaptor,
    .transfer_single = machine_i2c_transfer_single,
};

MP_DEFINE_CONST_OBJ_TYPE(
    machine_i2c_type,
    MP_QSTR_I2C,
    MP_TYPE_FLAG_NONE,
    make_new, machine_i2c_make_new,
    print, machine_i2c_print,
    protocol, &machine_i2c_p,
    locals_dict, &mp_machine_i2c_locals_dict
    );

// Called from the port soft-reset path (mp_main.c): the obj array is static
// BSS that survives soft reset with the SDK I2C peripheral still enabled.
// Free every instance so a re-init after reset starts from a clean state.
void machine_i2c_deinit_all(void) {
    for (int i = 0; i < I2C_ID_COUNT; i++) {
        machine_i2c_obj_t *self = &machine_i2c_obj[i];
        if (self->initialized) {
            i2c_reset(&self->i2c);
            machine_i2c_pins_release(self);
            self->initialized = false;
        }
    }
}
```

## src/machine_pin.h
```c
// ports/ameba-rtos-m/src/machine_pin.h
#pragma once
#include "py/obj.h"

extern const mp_obj_type_t machine_pin_type;
extern const mp_obj_type_t machine_pin_irq_type;

// Populate machine_pin_obj_table for the compiled SoC's pin banks.  Must be
// called once during startup before any machine.Pin use.
void machine_pin_table_init(void);
```
